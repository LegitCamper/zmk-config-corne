## boards/shields/corne/Kconfig.defconfig
```kconfig
if SHIELD_CORNE_DONGLE || SHILED_CORNE_LEFT || SHILED_CORNE_RIGHT 

config ZMK_SPLIT
    default y

config ZMK_BLE
	default y

endif

if SHIELD_CORNE_DONGLE

config ZMK_KEYBOARD_NAME
    default "Corne Dongle"

config ZMK_SPLIT_ROLE_CENTRAL
    default y

config ZMK_USB
	default y
    
endif

if SHILED_CORNE_LEFT || SHILED_CORNE_RIGHT

config ZMK_SPLIT_BLE
    default y

config ZMK_SPLIT_ROLE_CENTRAL
    default n

config ZMK_SLEEP
    default y

endif
```

## config/west.yml
```yaml
manifest:
  defaults:
    revision: v0.2
  remotes:
    - name: zmkfirmware
      url-base: https://github.com/zmkfirmware
    - name: bwshockley
      url-base: https://github.com/bwshockley
  projects:
    - name: zmk
      remote: zmkfirmware
      revision: main
      import: app/west.yml
    - name: zmk-dongle-screen
      remote: bwshockley
      revision: main
  self:
    path: config
```
