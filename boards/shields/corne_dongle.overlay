#include <dt-bindings/zmk/matrix_transform.h>
#import "corne_dongle.dtsi"

/ {
    chosen {
        zmk,kscan = &mock_kscan;
    };

    mock_kscan: mock_kscan_0 {
        compatible = "zmk,kscan-mock";
        columns = <0>;
        rows = <0>;
        events = <0>;
    };

	&default_transform {
	    col-offset = <6>;
	};
};
